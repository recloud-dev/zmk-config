/*
 * Copyright (c) 2023 Andrei Gaevskii
 *
 * SPDX-License-Identifier: MIT
 *
 * Board stub — real keymap lives at config/mriya.keymap
 * (included from mriya_left.keymap / mriya_right.keymap).
 */

#include "../../../mriya.keymap"
