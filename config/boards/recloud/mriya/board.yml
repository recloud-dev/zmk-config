## config/boards/recloud/mriya/board.yml
```yaml
boards:
  - name: mriya_left
    vendor: recloud
    socs:
      - name: nrf52840
        variants:
          - name: zmk
  - name: mriya_right
    vendor: recloud
    socs:
      - name: nrf52840
        variants:
          - name: zmk
```
